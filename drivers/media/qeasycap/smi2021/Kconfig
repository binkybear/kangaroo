## drivers/media/qeasycap/smi2021/Kconfig
```kconfig
config VIDEO_SMI2021
	tristate "Somagic SMI2021 USB video/audio capture support"
	help
	  This is a video4linux driver for SMI2021 based video capture devices.

	  To compile this driver as a module, choose M here: the
	  module will be called smi2021
```

## drivers/media/qeasycap/usbtv/Kconfig
```kconfig
config VIDEO_USBTV
        tristate "USBTV007 video capture support"
        ---help---
          This is a video4linux2 driver for USBTV007 based video capture devices.

          To compile this driver as a module, choose M here: the
          module will be called usbtv
```
